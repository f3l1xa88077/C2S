/*
 * interrupt.c
 *
 *  Created on: Dec 15, 2025
 *      Author: felix
 */

#include"interrupt.h"

extern Encoder_HandleTypeDef scroll_encoder;

// -------------------------- Interrupt callbacks --------------------------

/**
 * @brief GPIO EXTI rising edge callback.
 *
 * Handles rising edge interrupts generated by configured GPIO pins.
 * Used for encoder updates, menu button (BOOT0), and shutter trigger control.
 *
 * @param GPIO_Pin GPIO pin number that triggered the interrupt.
 */
void HAL_GPIO_EXTI_Rising_Callback(uint16_t GPIO_Pin)
{
    static uint32_t last_button_time = 0;
    const uint32_t debounce_ms = 200; // Debounce period in milliseconds

    // Encoder channel A or B interrupt
    if ((GPIO_Pin == SCROLL_A_Pin) || (GPIO_Pin == SCROLL_B_Pin))
    {
        Encoder_Update(&scroll_encoder, GPIO_Pin, 0);
    }
    // Menu select button (BOOT0 pin)
    else if (GPIO_Pin == BOOT0_Pin)
    {
        uint32_t now = HAL_GetTick();

        // Software debounce check
        if ((now - last_button_time) >= debounce_ms)
        {
            scroll_encoder.cfg.idx =
                (scroll_encoder.cfg.idx + 1) % scroll_encoder.cfg.num;

            last_button_time = now;
        }
    }
    // Shutter button pressed
    else if (GPIO_Pin == SHUTTER_Pin)
    {
        uint32_t now = HAL_GetTick();

        // Software debounce check
        if ((now - last_button_time) >= debounce_ms)
        {
            HAL_GPIO_WritePin(TRIGGER_GPIO_Port, TRIGGER_Pin, 1);
            last_button_time = now;
        }
    }
}


/**
 * @brief GPIO EXTI falling edge callback.
 *
 * Handles falling edge interrupts generated by configured GPIO pins.
 * Used for encoder updates, shutter release, and power state detection.
 *
 * @param GPIO_Pin GPIO pin number that triggered the interrupt.
 */
void HAL_GPIO_EXTI_Falling_Callback(uint16_t GPIO_Pin)
{
    // Encoder channel A or B interrupt
    if ((GPIO_Pin == SCROLL_A_Pin) || (GPIO_Pin == SCROLL_B_Pin))
    {
        Encoder_Update(&scroll_encoder, GPIO_Pin, 1);
    }
    // Shutter button released
    else if (GPIO_Pin == SHUTTER_Pin)
    {
        HAL_GPIO_WritePin(TRIGGER_GPIO_Port, TRIGGER_Pin, 0);
    }
    // Power state pin changed (system shutting down)
    else if (GPIO_Pin == PWR_STATE_Pin)
    {
        return; // Signal system to begin shutdown sequence
    }
}
