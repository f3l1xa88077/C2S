/*
 * interrupt.c
 *
 *  Created on: 19/06/2026
 *      Author: felix
 */

#include"interrupt.h"

// -------------------------- Interrupt callbacks --------------------------

extern volatile bool c2s_should_sleep;
static volatile uint32_t last_button_time = 0;

// External Camera Variables
extern uint8_t FrameProcessed;
extern uint32_t pBuffer[];
extern DCMI_HandleTypeDef hdcmi;


/**
 * @brief GPIO EXTI rising edge callback.
 *
 * Handles rising edge interrupts generated by configured GPIO pins.
 *
 * @param GPIO_Pin GPIO pin number that triggered the interrupt.
 */
void HAL_GPIO_EXTI_Rising_Callback(uint16_t GPIO_Pin)
{

    // Shutter button pressed
    if (GPIO_Pin == SHUTTER_Pin)
    {
        uint32_t now = HAL_GetTick();

        // Software de-bounce check
        if ((now - last_button_time) >= 200)
        {
        	if (!FrameProcessed)
        	{
        		// Open DMA and listen for image
        		//HAL_DCMI_Start_DMA(&hdcmi, DCMI_MODE_SNAPSHOT, (uint32_t)pBuffer, MAX_PICTURE_BUFF); // Cast pBuffer to obtain address
        	}

        }
    }

    // Rising edge of NCS (Exit)
    else if (GPIO_Pin == WAKEUP_Pin)
    {
    	c2s_should_sleep = 1;
    }
}


/**
 * @brief GPIO EXTI falling edge callback.
 *
 * Handles falling edge interrupts generated by configured GPIO pins.
 * Used for encoder updates, shutter release, and power state detection.
 *
 * @param GPIO_Pin GPIO pin number that triggered the interrupt.
 */
void HAL_GPIO_EXTI_Falling_Callback(uint16_t GPIO_Pin)
{
    // Shutter button released
    if (GPIO_Pin == SHUTTER_Pin)
    {
        //
    }
    // Falling edge of NCS (Enter)
    else if (GPIO_Pin == WAKEUP_Pin)
    {
    	//
    }
}
